/*************************************************************/
// project    :	221-3059-1428
// driver IC  :	st7565R
// LCD        :	1/65 duty, 1/9bias, 8.8V vop
// interface  :	SPI
// ver        :	00
// date       :  -07
// other      :	VDD 3.1v
/**************************************************************/
#include "st7565r_lcd.h"

//const uint8_t char_8x16[24][16];
extern const uint8_t char_7x8[75][8];
extern const uint8_t hz_12x12[66][12];
extern const uint8_t logo[];
extern const uint8_t char_8x12[39][16];



void ST7565_IO_Delay(__IO uint16_t t)
{
    /* Decrement nCount value */
    while (t != 0)
    {
        t--;
    }
}


void ST7565_Write(uint8_t dat,uint8_t rs) //rs == 1 data rs==0  cmd
{
    uint8_t i;

    IO_ST7565_CS_0;
    if(!rs)
    {
        IO_ST7565_RS_0; //Command
    }
    else
    {
        IO_ST7565_RS_1;
    }

    for(i=0; i<8; i++)
    {
        IO_ST7565_SCK_0;
        if(dat&0x80)
            IO_ST7565_SDA_1;
        else
            IO_ST7565_SDA_0;
        IO_ST7565_SCK_1;
        dat<<=1;
    }

    IO_ST7565_CS_1;
    IO_ST7565_RS_1;

}

void writec(uint8_t com)
{
    ST7565_Write(com,0);
}

void writed(uint8_t dat)
{
    ST7565_Write(dat,1);
}


void lcd_init(void)
{
    IO_ST7565_CS_0;
    IO_ST7565_RST_0;
    ST7565_IO_Delay(1000);
    IO_ST7565_RST_1;
    ST7565_IO_Delay(1000);
    ST7565_Write(0xE2,0); //Soft Reset
    ST7565_Write(0xA2,0); //Duty bias set  0xA2 is light 0xA3 is dark
    //ST7565_Write(0xA7,0); //0xA7 reverse 0xA6 normal default normal
    ST7565_Write(0xA0,0); //ADC select S0->S131(?????S1-S128)
    ST7565_Write(0xC8,0); //com1 --> com64
    ST7565_Write(0x23,0); //V0 Voltage Regulator Internal Resistor Ratio Set 0x20~0x27
    ST7565_IO_Delay(500);
    ST7565_Write(0x81,0); //V0 voltage set first cmd
    ST7565_Write(0x2f & 0x3F,0); //following V0 voltage set 0x00~0x3F
    ST7565_IO_Delay(500);
    ST7565_Write(0xF8,0); //Booster Ratio Select Mode Set first cmd
    ST7565_Write(0x00 & 0x03,0); //following Booset Ratio Register Set 0x00~0x03
    ST7565_IO_Delay(500);
    ST7565_Write(0x2F,0); //power control all on
    ST7565_IO_Delay(500);
    ST7565_Write(0x40 + 0x00,0); //0x40 + Display Start Line(0)
    clear_screen();
    ST7565_Write(0xAF,0); //Display ON: 0xaf, OFF:0xae

    show_pic_128x64();
    LCD_BKLIGHT_1;//背光开

}


void lcd_address(uint8_t page,uint8_t column)
{
    column=column-1; //我们平常所说的第 1 列，在 LCD 驱动 IC 里是第 0 列。所以在这里减去 1.
    page=page-1;
    writec(0xb0+page); //设置页地址。每页是 8 行。一个画面的 64 行被分成 8 个页。我们平常所说的第 1 页，在 LCD 驱动IC 里是第 0 页，所以在这里减去 1*/
    writec(((column>>4)&0x0f)+0x10); //设置列地址的高 4 位
    writec(column&0x0f); //设置列地址的低 4 位
}

void clear_screen(void)
{
    uint8_t i,j;

    for(i=0; i<8; i++)
    {
        lcd_address(1+i,1);
        for(j=0; j<128; j++)
        {
            writed(0x00);
        }
    }

}


void show_str_8x12(uint16_t page,uint16_t column,uint8_t *text)
{
    uint16_t i=0,j,k,n;

    while(text[i]>0x00)
    {
        if((text[i]>=0x30)&&(text[i]<=0x56))
        {
            j=text[i]-0x30;
        }
        else if(text[i]==0x20)//空格,
        {
            j=16;
        }
        else if(text[i]==0x2d)
        {
            j=15;
        }
        else
        {
            i++;
            continue;
        }

        for(n=0; n<2; n++)
        {
            lcd_address(page+n,column);
            for(k=0; k<8; k++)
            {
                writed(char_8x12[j][k+8*n]);/*显示ASCII 字到 LCD 上，y 为页地址，x 为列地址，最后为数据*/
            }
        }
        i++;
        column+=8;

    }
}


void show_str_7x8(uint16_t page,uint16_t column,uint8_t *text)
{
    uint16_t i=0,j,k;

    while(text[i]>0x00)
    {
        if((text[i]>=0x30)&&(text[i]<=0x7b))
        {
            j=text[i]-0x30;
        }
        else if(text[i]==0x20)//' '空格,
        {
            j=16;
        }
        else
        {
            i++;
            continue;
        }

        lcd_address(page,column);
        for(k=0; k<8; k++)
        {
            writed(char_7x8[j][k]);/*显示ASCII 字到 LCD 上，y 为页地址，x 为列地址，最后为数据*/
        }
        i++;
        column+=8;//横
    }
}

void show_hz_12x12(uint16_t page,uint16_t column,uint8_t *text)
{
    uint16_t i=0,j,k,n;

    while(text[i]>0x00)
    {
        if((text[i]>=0x41)&&(text[i]<=0x82))
        {
            j=text[i]-0x41;
            for(n=0; n<2; n++)
            {
                lcd_address(page+n,column);
                for(k=0; k<12; k++)
                {
                    writed(hz_12x12[j][k+12*n]);/*显示ASCII 字到 LCD 上，y 为页地址，x 为列地址，最后为数据*/
                }
            }
            i++;
            column+=12;
        }
        else
            i++;
    }

}


//显示128x64点阵图像
void show_pic_128x64(void)
{
    uint8_t i,j;
    uint16_t k=16;

    for(j=1; j<=8; j++)
    {
        lcd_address(j,0);
        for(i=0; i<128; i++)
        {
            writed(logo[k++]);
        }
    }
}

#if 0

/*
//显示128x16点阵图像
void show_pic_128x16(uint8_t page,uint8_t column,uint8_t *dp)
{
    uint8_t i,j;
    for(j=0; j<2; j++)
    {
        lcd_address(page+j,column);
        for(i=0; i<128; i++)
        {
            writed(*dp++);
        }
    }
}

//显示128x16点阵图像
void show_pic_64x16(uint8_t page,uint8_t column,uint8_t *dp)
{
    uint8_t i,j;
    for(j=0; j<2; j++)
    {
        lcd_address(page+j,column);
        for(i=0; i<64; i++)
        {
            writed(*dp++);
        }
    }
}



void lcd_test(void)
{
    lcd_init();

    //show_str_8x16(3,1,"A?B@@1234@@456FG");
    show_str_7x8(8,1,"ABCD0123456789");
    //show_hz_12x12(5,1,"UWY[");
#if 0
    show_hz_12x12(1,1,"ACEG");
    show_str_7x8(1,100,"003");
    show_str_8x12(5,1,"A?B@@@@123400FG");
    show_hz_12x12(5,32,"QS");
    show_str_8x12(7,1,"C?D@@@@340000EG");
    show_hz_12x12(7,32,"QS");
//#else
    show_hz_12x12(1,1,"IKMO]UWY[");
    show_str_8x12(1,110,"EG");
    show_str_8x12(3,1,"A@@2345@12340");
    show_str_8x12(5,1,"B@@2345@12340");
    show_str_8x12(7,1,"C@@2345@12340");
#endif

}

*/


void show_str_8x16(uint16_t page,uint16_t column,uint8_t *text)
{
    uint16_t i=0,j,k,n;

    while(text[i]>0x00)
    {
        if((text[i]>=0x30)&&(text[i]<=0x47))
        {
            j=text[i]-0x30;
            for(n=0; n<2; n++)
            {
                lcd_address(page+n,column);
                for(k=0; k<8; k++)
                {
                    writed(char_8x16[j][k+8*n]);/*显示ASCII 字到 LCD 上，y 为页地址，x 为列地址，最后为数据*/
                }
            }
            i++;
            column+=8;
        }
        else
            i++;
    }
}



const uint8_t char_8x16[24][16]=//宽x高
{
    0x00,0xE0,0xF0,0x18,0x08,0x18,0xF0,0xE0,0x00,0x0F,0x1F,0x30,0x20,0x30,0x1F,0x0F,/*"0",0*/

    0x00,0x10,0x10,0xF8,0xF8,0x00,0x00,0x00,0x00,0x20,0x20,0x3F,0x3F,0x20,0x20,0x00,/*"1",1*/
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    0x00,0xC0,0xE0,0x20,0x20,0x20,0x20,0x00,0x00,0x08,0x09,0x09,0x09,0x0F,0x06,0x00,/*"G",23*///替代"s"

};

#endif

const uint8_t char_8x12[39][16]=//宽x高
{
    {0xF8,0xFC,0x06,0x02,0x06,0xFC,0xF8,0x00,0x0F,0x1F,0x30,0x20,0x30,0x1F,0x0F,0x00},
    {0x00,0x04,0x04,0xFE,0xFE,0x00,0x00,0x00,0x00,0x00,0x00,0x3F,0x3F,0x00,0x00,0x00},
    {0x18,0x1C,0x06,0x02,0xC6,0xFC,0x38,0x00,0x30,0x38,0x2E,0x27,0x21,0x20,0x20,0x00},
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    {0x40,0x60,0x70,0xF8,0xDC,0xCE,0x40,0x00,0x00,0x0E,0x07,0x03,0x01,0x00,0x00,0x00}
};


const uint8_t hz_12x12[66][12]=
{
    {0x88,0x88,0xFF,0x48,0x00,0xFE,0x42,0xC2,0x52,0x52,0xCE,0x00},
    {0x00,0x08,0x0F,0x00,0x00,0x0F,0x08,0x05,0x02,0x05,0x08,0x00},
    {0x92,0xBF,0xAA,0xBA,0xCF,0xBA,0xC4,0xAB,0x92,0xAE,0xC2,0x00},
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    {0x0F,0x08,0x08,0x08,0x0B,0x0A,0x0A,0x0B,0x09,0x08,0x08,0x0F}
};

/*
0(0) 1(1) 2(2) 3(3) 4(4) 5(5) 6(6) 7(7) 8(8) 9(9) :(10) ;(11) <(12) =(13) >(14) ?(15)
@(16) A(17) B(18) C(19) D(20) E(21) F(22) G(23) H(24) I(25) J(26) K(27) L(28) M(29) N(30) O(31)
P(32) Q(33) R(34) S(35) T(36) U(37) V(38) W(39) X(40) Y(41) Z(42) [(43) \(44) ](45) ^(46) _(47)
`(48) a(49) b(50) c(51) d(52) e(53) f(54) g(55) h(56) i(57) j(58) k(59) l(60) m(61) n(62) o(63)
p(64) q(65) r(66) s(67) t(68) u(69) v(70) w(71) x(72) y(73) z(74)

*/
const uint8_t char_7x8[75][8]=
{
    {0x00,0x3C,0x66,0x42,0x42,0x66,0x3C,0x00},
    {0x00,0x04,0x04,0x04,0x7E,0x00,0x00,0x00},
    {0x00,0x64,0x72,0x52,0x52,0x4A,0x4C,0x00},
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    {0x00,0x48,0x68,0x68,0x58,0x48,0x48,0x00}
};

/* Absolute address: logo[] at 0x00F000 in Flash */
#if defined(_IAR_)
#pragma location = 0x00F000//定位于flash内地址0x008000 - 0x010000
#endif
__ROOT const uint8_t logo[1040]=

{

    /* Header (16 bytes) */
    0x12, 0x34, 0x56, 0x78, 0x00, 0x00, 0x00, 0x00,
    0x00, 0x00, 0x00, 0x00, 0x00, 0x00, 0x00, 0x00,

    /* Page 0 (rows 0-7) */
    0xFF, 0xFF, 0xFF, 0xFF, 0xFF, 0xFF, 0xFF, 0xFF, 0xFF, 0xFF, 0xFF, 0xFF, 0xFF, 0xFF, 0xFF, 0xFF,
    0xFF, 0xFF, 0xFF, 0xFF, 0xFF, 0xFF, 0xFF, 0x7F, 0x7F, 0x7F, 0xFF, 0xFF, 0xFF, 0xFF, 0xFF, 0xFF,
    0xFF, 0xFF, 0xFF, 0xFF, 0xFF, 0xFF, 0xFF, 0xFF, 0xFF, 0xFF, 0xFF, 0xFF, 0xFF, 0xFF, 0xFF, 0xFF,
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    0xFF, 0xFF, 0xFF, 0xFF, 0xFF, 0xFF, 0xFF, 0xFF, 0xFF, 0xFF, 0xFF, 0xFF, 0xFF, 0xFF, 0xFF, 0xFF,

    /* Page 1 (rows 8-15) */
    0xFF, 0xFF, 0xFF, 0xFF, 0xFF, 0xFF, 0xFF, 0xFF, 0xFF, 0xFF, 0xFF, 0xFF, 0xFF, 0xFF, 0xFF, 0x3F,
    0x0F, 0x07, 0x03, 0xC1, 0xE0, 0xE0, 0xF0, 0xF0, 0xF0, 0xF0, 0xF0, 0xE0, 0xE0, 0xC1, 0xC3, 0xE7,
    0xFF, 0xFF, 0xFF, 0xFF, 0xFF, 0xFF, 0xFF, 0xFF, 0xFF, 0xFF, 0xFF, 0xFF, 0xFF, 0xFF, 0xFF, 0xFF,
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    0xFF, 0xFF, 0xFF, 0xFF, 0xFF, 0xFF, 0xFF, 0xFF, 0xFF, 0xFF, 0xFF, 0xFF, 0xFF, 0xFF, 0xFF, 0xFF,

    /* Page 2 (rows 16-23) */
    0xFF, 0xFF, 0xFF, 0xFF, 0xFF, 0xFF, 0xFF, 0xFF, 0xFF, 0xFF, 0xFF, 0xFF, 0xFF, 0x1F, 0x00, 0x00,
    0x00, 0xFC, 0xFF, 0xFF, 0xFF, 0xFF, 0xFF, 0xFF, 0x7F, 0x3F, 0x3F, 0x3F, 0x3F, 0x3F, 0x3F, 0x3F,
    0x3F, 0x3F, 0x7F, 0xFF, 0xFF, 0x7F, 0x1F, 0x0F, 0x0F, 0x07, 0x87, 0x87, 0x87, 0x0F, 0x0F, 0x1F,
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    0xFF, 0xFF, 0xFF, 0xFF, 0xFF, 0xFF, 0xFF, 0xFF, 0xFF, 0xFF, 0xFF, 0xFF, 0xFF, 0xFF, 0xFF, 0xFF,

    /* Page 3 (rows 24-31) */
    0xFF, 0xFF, 0xFF, 0xFF, 0xFF, 0xFF, 0xFF, 0xFF, 0xFF, 0xFF, 0xFF, 0xFF, 0xFF, 0xF8, 0x80, 0x00,
    0x00, 0x1F, 0xFF, 0xFF, 0xFF, 0xFF, 0xFF, 0xFF, 0xFD, 0xF8, 0xF8, 0xF8, 0xF8, 0xF8, 0xF8, 0x08,
    0x00, 0x00, 0xE0, 0xFF, 0x03, 0x00, 0x00, 0xF8, 0xFE, 0xFF, 0xFF, 0xFF, 0xFF, 0xFF, 0xFC, 0x00,
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    0xFF, 0xFF, 0xFF, 0xFF, 0xFF, 0xFF, 0xFF, 0xFF, 0xFF, 0xFF, 0xFF, 0xFF, 0xFF, 0xFF, 0xFF, 0xFF,

    /* Page 4 (rows 32-39) */
    0xFF, 0xFF, 0xFF, 0xFF, 0xFF, 0xFF, 0xFF, 0xFF, 0xFF, 0xFF, 0xFF, 0xFF, 0xFF, 0xFF, 0xFF, 0xFE,
    0xF8, 0xF0, 0xE0, 0xC1, 0x83, 0x87, 0x07, 0x07, 0x0F, 0x07, 0x07, 0x87, 0x83, 0xC1, 0xE0, 0xF0,
    0xF8, 0xFE, 0xFF, 0xFF, 0xFE, 0xF0, 0xE0, 0xC0, 0x83, 0x07, 0x0F, 0x0F, 0x07, 0x87, 0x81, 0xC0,
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    0xFF, 0xFF, 0xFF, 0xFF, 0xFF, 0xFF, 0xFF, 0xFF, 0xFF, 0xFF, 0xFF, 0xFF, 0xFF, 0xFF, 0xFF, 0xFF,

    /* Page 5 (rows 40-47) */
    0xFF, 0xFF, 0xFF, 0xFF, 0xFF, 0xFF, 0xFF, 0xFF, 0xFF, 0xFF, 0xFF, 0xFF, 0xFF, 0xFF, 0xFF, 0xFF,
    0xFF, 0xFF, 0xFF, 0xFF, 0xFF, 0xFF, 0xFF, 0xFF, 0xFF, 0xFF, 0xFF, 0xFF, 0xFF, 0xFF, 0xFF, 0xFF,
    0xFF, 0xFF, 0xFF, 0xFF, 0xFF, 0xFF, 0xFF, 0xFF, 0xFF, 0xFF, 0xFF, 0xFF, 0xFF, 0xFF, 0xFF, 0xFF,
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    0xFF, 0xFF, 0xFF, 0xFF, 0xFF, 0xFF, 0xFF, 0xFF, 0xFF, 0xFF, 0xFF, 0xFF, 0xFF, 0xFF, 0xFF, 0xFF,

    /* Page 6 (rows 48-55) */
    0xFF, 0xFF, 0xFF, 0xFF, 0xFF, 0xFF, 0xFF, 0xFF, 0xFF, 0xFF, 0xFF, 0xFF, 0xFF, 0xFF, 0xFF, 0xFF,
    0xFF, 0xFF, 0xFF, 0xFF, 0xFF, 0xFF, 0xFF, 0xFF, 0xFF, 0xFF, 0xFF, 0xFF, 0xFF, 0xFF, 0xFF, 0xFF,
    0xFF, 0xFF, 0xFF, 0xFF, 0xFF, 0xFF, 0xFF, 0xFF, 0xFF, 0xFF, 0xFF, 0xFF, 0xFF, 0xFF, 0xFF, 0xFF,
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    0xFF, 0xFF, 0xFF, 0xFF, 0xFF, 0xFF, 0xFF, 0xFF, 0xFF, 0xFF, 0xFF, 0xFF, 0xFF, 0xFF, 0xFF, 0xFF,

    /* Page 7 (rows 56-63) */
    0xFF, 0xFF, 0xFF, 0xFF, 0xFF, 0xFF, 0xFF, 0xFF, 0xFF, 0xFF, 0xFF, 0xFF, 0xFF, 0xFF, 0xFF, 0xFF,
    0xFF, 0xFF, 0xFF, 0xFF, 0xFF, 0xFF, 0xFF, 0xFF, 0xFF, 0xFF, 0xFF, 0xFF, 0xFF, 0xFF, 0xFF, 0xFF,
    0xFF, 0xFF, 0xFF, 0xFF, 0xFF, 0xFF, 0xFF, 0xFF, 0xFF, 0xFF, 0xFF, 0xFF, 0xFF, 0xFF, 0xFF, 0xFF,
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    0xFF, 0xFF, 0xFF, 0xFF, 0xFF, 0xFF, 0xFF, 0xFF, 0xFF, 0xFF, 0xFF, 0xFF, 0xFF, 0xFF, 0xFF, 0xFF


};





